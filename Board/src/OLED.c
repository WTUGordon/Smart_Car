/******************************************************
 * 龙邱库移植到野火库。
 * by          Gordon
 * 时间        2019/1/11
 * 文件名      OLED.c
 * 原文件名    LQ12864.c
 * 内容        逐飞小旋风硬件二值化库
 * 软件        IAR7.3
 * 单片机      MK60DN512ZVLQ10

******************************************************/



#include "include.h"
//--------这里修改定义端口------//

//---------别忘了初始化定义的这些IO口的方向--------------------//





#define X_WIDTH 129
#define Y_WIDTH 64


//======================================
const uint8 F6x8[][6] =
{
    { 0x00, 0x00, 0x00, 0x00, 0x00, 0x00 },   // sp
    { 0x00, 0x00, 0x00, 0x2f, 0x00, 0x00 },   // !
    { 0x00, 0x00, 0x07, 0x00, 0x07, 0x00 },   // "
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    { 0x14, 0x14, 0x14, 0x14, 0x14, 0x14 }    // horiz lines
};


void LCD_WrDat(unsigned char data)
{
	unsigned char i=8;
	//LCD_CS=0;;
	LCD_DC=1;;
  LCD_SCL=0;;
  //asm("nop");
  while(i--)
  {
    if(data&0x80){LCD_SDA=1;}
    else{LCD_SDA=0;}
    LCD_SCL=1;
    asm("nop");;
		//asm("nop");
    LCD_SCL=0;;
    data<<=1;
  }
	//LCD_CS=1;
}

void LCD_WrCmd(unsigned char cmd)
{
	unsigned char i=8;

	//LCD_CS=0;;
	LCD_DC=0;;
  LCD_SCL=0;;
  //asm("nop");
  while(i--)
  {
    if(cmd&0x80){LCD_SDA=1;}
    else{LCD_SDA=0;;}
    LCD_SCL=1;;
    asm("nop");;
		//asm("nop");
    LCD_SCL=0;;
    cmd<<=1;;
  }
	//LCD_CS=1;
}

void LCD_Set_Pos(unsigned char x, unsigned char y)
{
  LCD_WrCmd(0xb0+y);
  LCD_WrCmd(((x&0xf0)>>4)|0x10);
  LCD_WrCmd((x&0x0f)|0x01);
}


void LCD_Fill(unsigned char bmp_data)
{
	unsigned char y,x;

	for(y=0;y<8;y++)
	{
		LCD_WrCmd(0xb0+y);
		LCD_WrCmd(0x01);
		LCD_WrCmd(0x10);
		for(x=0;x<X_WIDTH;x++)
			LCD_WrDat(bmp_data);
	}
}


void LCD_CLS(void)
{
	unsigned char y,x;
	for(y=0;y<8;y++)
	{
		LCD_WrCmd(0xb0+y);
		LCD_WrCmd(0x01);
		LCD_WrCmd(0x10);
		for(x=0;x<X_WIDTH;x++)
			LCD_WrDat(0);
	}
}
void LCD_DLY_ms(unsigned int ms)
{
  unsigned int a;
  while(ms)
  {
    a=1335;
    while(a--);
    ms--;
  }
  //delayms(ms);
  return;
}


void LCD_Init(void)
{
    //-----端口初始化----//
      gpio_init(PTC19,GPO,0);
      gpio_init(PTC18,GPO,0);
      gpio_init(PTC17,GPO,0);
      gpio_init(PTC16,GPO,0);


	LCD_SCL=1;
	//LCD_CS=1;	//预制SLK和SS为高电平

	LCD_RST=0;
	LCD_DLY_ms(50);
	LCD_RST=1;

  LCD_WrCmd(0xae);//--turn off oled panel
  LCD_WrCmd(0x00);//---set low column address
  LCD_WrCmd(0x10);//---set high column address
  LCD_WrCmd(0x40);//--set start line address  Set Mapping RAM Display Start Line (0x00~0x3F)
  LCD_WrCmd(0x81);//--set contrast control register
  LCD_WrCmd(0xc8); // Set SEG Output Current Brightness
  LCD_WrCmd(0xa1);//--Set SEG/Column Mapping     0xa0左右反置 0xa1正常
  LCD_WrCmd(0xc8);//Set COM/Row Scan Direction   0xc0上下反置 0xc8正常
  LCD_WrCmd(0xa6);//--set normal display
 // LCD_WrCmd(0xa8);//--set multiplex ratio(1 to 64)
 // LCD_WrCmd(0x3f);//--1/64 duty
  LCD_WrCmd(0xd3);//-set display offset	Shift Mapping RAM Counter (0x00~0x3F)
  LCD_WrCmd(0x00);//-not offset
  LCD_WrCmd(0xd5);//--set display clock divide ratio/oscillator frequency
  LCD_WrCmd(0x80);//--set divide ratio, Set Clock as 100 Frames/Sec
  LCD_WrCmd(0xd9);//--set pre-charge period
  LCD_WrCmd(0xf1);//Set Pre-Charge as 15 Clocks & Discharge as 1 Clock
  LCD_WrCmd(0xda);//--set com pins hardware configuration
  LCD_WrCmd(0x12);
  LCD_WrCmd(0xdb);//--set vcomh
  LCD_WrCmd(0x40);//Set VCOM Deselect Level
  LCD_WrCmd(0x20);//-Set Page Addressing Mode (0x00/0x01/0x02)
  LCD_WrCmd(0x00);//
  LCD_WrCmd(0x8d);//--set Charge Pump enable/disable
  LCD_WrCmd(0x14);//--set(0x10) disable
  LCD_WrCmd(0xa4);// Disable Entire Display On (0xa4/0xa5)
  LCD_WrCmd(0xa6);// Disable Inverse Display On (0xa6/a7)
  LCD_WrCmd(0xaf);//--turn on oled panel
  LCD_Fill(0x00);  //初始清屏
  LCD_Set_Pos(0,0);

}



//==============================================================
//函数名： void LCD_PutPixel(unsigned char x,unsigned char y)
//功能描述：绘制一个点（x,y）
//参数：真实坐标值(x,y),x的范围0～127，y的范围0～64
//返回：无
//==============================================================
void LCD_PutPixel(unsigned char x,unsigned char y)
{
	unsigned char data1;  //data1当前点的数据

	LCD_Set_Pos(x,(unsigned char)(y>>3));
	data1 =(unsigned char)(0x01<<(y%8));
	LCD_WrCmd((unsigned char)(0xb0+(y>>3)));
	LCD_WrCmd((unsigned char)(((x&0xf0)>>4)|0x10));
	LCD_WrCmd((unsigned char)((x&0x0f)|0x00));
	LCD_WrDat(data1);
}


//==============================================================
//函数名： void LCD_Rectangle(unsigned char x1,unsigned char y1,
//                   unsigned char x2,unsigned char y2,unsigned char color,unsigned char gif)
//功能描述：绘制一个实心矩形
//参数：左上角坐标（x1,y1）,右下角坐标（x2，y2）
//      其中x1、x2的范围0～127，y1，y2的范围0～63，即真实坐标值
//返回：无
//==============================================================
void LCD_Rectangle(unsigned char x1,unsigned char y1,unsigned char x2,unsigned char y2,unsigned char gif)
{
	unsigned char n;

	LCD_Set_Pos(x1,y1>>3);
	for(n=x1;n<=x2;n++)
	{
		LCD_WrDat(0x01<<(y1%8));
		if(gif == 1) 	LCD_DLY_ms(50);
	}
	LCD_Set_Pos(x1,y2>>3);
  for(n=x1;n<=x2;n++)
	{
		LCD_WrDat(0x01<<(y2%8));
		if(gif == 1) 	LCD_DLY_ms(5);
	}

}

//==============================================================
//函数名：LCD_P6x8Str(unsigned char x,unsigned char y,unsigned char *p)
//功能描述：写入一组标准ASCII字符串
//参数：显示的位置（x,y），y为页范围0～7，要显示的字符串
//返回：无
//==============================================================
void LCD_P6x8Str(unsigned char x,unsigned char y,unsigned char ch[])
{
  unsigned char c=0,i=0,j=0;
  while (ch[j]!='\0')
  {
    c =ch[j]-32;
    if(x>126){x=0;y++;}
    LCD_Set_Pos(x,y);
  	for(i=0;i<6;i++)
  	  LCD_WrDat(F6x8[c][i]);
  	x+=6;
  	j++;
  }
}



void LCD_ClrDot(unsigned char x)  //线性CCD使用
{
	LCD_Set_Pos(x,6);
	LCD_WrCmd((unsigned char)(0xb0+6));
	LCD_WrCmd((unsigned char)(((x&0xf0)>>4)|0x10));
	LCD_WrCmd((unsigned char)((x&0x0f)|0x00));
	LCD_WrDat(0x00);

	LCD_Set_Pos(x,7);
	LCD_WrCmd((unsigned char)(0xb0+7));
	LCD_WrCmd((unsigned char)(((x&0xf0)>>4)|0x10));
	LCD_WrCmd((unsigned char)((x&0x0f)|0x00));
	LCD_WrDat(0x00);
}

//-------------------------------------------------------------------------------------------------------------------
//  @brief      OLED显示图像
//  @param      high  		图像高度
//  @param      width 		图像宽度
//  @param      *p    		图像地址（数组）
//  @param      value 		二值化阀值
//  @return     void
//  @since      v1.0
//  Sample usage:
//-------------------------------------------------------------------------------------------------------------------
void dis_bmp(uint16 high, uint16 width, uint8 *p,uint8 value)
{
    int16 i,j;
    int16 temp,temp1;
    uint8 dat;


    temp1 = high%8;
    if(temp1 == 0) temp = high/8;
    else           temp = high/8+1;


    for(i=0; i<temp; i++)
    {
        LCD_Set_Pos(0,i);
        for(j=0; j<width; j++)
        {
            dat = 0;
            if( i<(temp-1) || !temp1 || temp1>=1)dat |= (*(p+i*8*width+j+width*0) > value? 1: 0)<<0;
            if( i<(temp-1) || !temp1 || temp1>=2)dat |= (*(p+i*8*width+j+width*1) > value? 1: 0)<<1;
            if( i<(temp-1) || !temp1 || temp1>=3)dat |= (*(p+i*8*width+j+width*2) > value? 1: 0)<<2;
            if( i<(temp-1) || !temp1 || temp1>=4)dat |= (*(p+i*8*width+j+width*3) > value? 1: 0)<<3;
            if( i<(temp-1) || !temp1 || temp1>=5)dat |= (*(p+i*8*width+j+width*4) > value? 1: 0)<<4;
            if( i<(temp-1) || !temp1 || temp1>=6)dat |= (*(p+i*8*width+j+width*5) > value? 1: 0)<<5;
            if( i<(temp-1) || !temp1 || temp1>=7)dat |= (*(p+i*8*width+j+width*6) > value? 1: 0)<<6;
            if( i<(temp-1) || !temp1 || temp1>=8)dat |= (*(p+i*8*width+j+width*7) > value? 1: 0)<<7;

            LCD_WrDat(dat);
        }
    }
}